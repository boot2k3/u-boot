## board/x92/Kconfig
```kconfig
config X92
	bool "Support X92 q200 board"
	default n

if X92
source "board/x92/x92/Kconfig"
endif
```

## board/x92/x92/Kconfig
```kconfig
if TARGET_MESON_GX

config SYS_CPU
	string
	default "armv8"

config SYS_BOARD
	string
	default "x92"

config SYS_VENDOR
	string
	default "x92"

config SYS_SOC
	string
	default "gxl"

config SYS_CONFIG_NAME
	default "x92"

endif
```
